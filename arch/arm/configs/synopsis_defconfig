## arch/arm/configs/synopsis_defconfig
```kconfig
# CONFIG_ARM_PATCH_PHYS_VIRT is not set
# CONFIG_BLK_DEV_BSG is not set
# CONFIG_CORE_DUMP_DEFAULT_ELF_HEADERS is not set
# CONFIG_DEBUG_PREEMPT is not set
# CONFIG_DEVICE_CHECK is not set
# CONFIG_DEVKMEM is not set
# CONFIG_EXT3_DEFAULTS_TO_ORDERED is not set
# CONFIG_FB_MSM_BACKLIGHT is not set
# CONFIG_HW_RANDOM is not set
# CONFIG_I2C_MSM is not set
# CONFIG_INPUT_KEYBOARD is not set
# CONFIG_INPUT_MOUSE is not set
# CONFIG_INPUT_MOUSEDEV is not set
# CONFIG_LEGACY_PTYS is not set
# CONFIG_LOCALVERSION_AUTO is not set
# CONFIG_MACH_MSM7627A_EVB is not set
# CONFIG_MACH_MSM7627A_QRD1 is not set
# CONFIG_MACH_MSM7627A_QRD3 is not set
# CONFIG_MACH_MSM7X27_FFA is not set
# CONFIG_MACH_MSM7X27_SURF is not set
# CONFIG_MACH_MSM8625_EVB is not set
# CONFIG_MACH_MSM8625_QRD7 is not set
# CONFIG_MEDIA_TUNER_MAX2165 is not set
# CONFIG_MEDIA_TUNER_MC44S803 is not set
# CONFIG_MEDIA_TUNER_MT2060 is not set
# CONFIG_MEDIA_TUNER_MT2063 is not set
# CONFIG_MEDIA_TUNER_MT20XX is not set
# CONFIG_MEDIA_TUNER_MT2131 is not set
# CONFIG_MEDIA_TUNER_MT2266 is not set
# CONFIG_MEDIA_TUNER_MXL5005S is not set
# CONFIG_MEDIA_TUNER_MXL5007T is not set
# CONFIG_MEDIA_TUNER_QT1010 is not set
# CONFIG_MEDIA_TUNER_SIMPLE is not set
# CONFIG_MEDIA_TUNER_TDA18212 is not set
# CONFIG_MEDIA_TUNER_TDA18218 is not set
# CONFIG_MEDIA_TUNER_TDA18271 is not set
# CONFIG_MEDIA_TUNER_TDA827X is not set
# CONFIG_MEDIA_TUNER_TDA8290 is not set
# CONFIG_MEDIA_TUNER_TDA9887 is not set
# CONFIG_MEDIA_TUNER_TEA5761 is not set
# CONFIG_MEDIA_TUNER_TEA5767 is not set
# CONFIG_MEDIA_TUNER_XC2028 is not set
# CONFIG_MEDIA_TUNER_XC4000 is not set
# CONFIG_MEDIA_TUNER_XC5000 is not set
# CONFIG_MMC_BLOCK_BOUNCE is not set
# CONFIG_MMC_BLOCK_TEST is not set
# CONFIG_MSM_DALRPC_TEST is not set
# CONFIG_MSM_DMA_TEST is not set
# CONFIG_MSM_FIQ_SUPPORT is not set
# CONFIG_MSM_HW3D is not set
# CONFIG_MSM_ONCRPCROUTER_DEBUG is not set
# CONFIG_MSM_RESET_MODEM is not set
# CONFIG_MSM_RPCSERVER_TIME_REMOTE is not set
# CONFIG_MSM_RPC_PING is not set
# CONFIG_MSM_RPC_PROC_COMM_TEST is not set
# CONFIG_MSM_SMD_DEBUG is not set
# CONFIG_MSM_SMD_NMEA is not set
# CONFIG_MSM_SMD_QMI is not set
# CONFIG_MSM_STACKED_MEMORY is not set
# CONFIG_RCU_CPU_STALL_VERBOSE is not set
# CONFIG_RC_CORE is not set
# CONFIG_SCHED_DEBUG is not set
# CONFIG_SERIAL_MSM_CLOCK_CONTROL is not set
# CONFIG_SERIO is not set
# CONFIG_SLUB_DEBUG is not set
# CONFIG_SRECORDER_MSM is not set
# CONFIG_SRECORDER_POWERCOLLAPS is not set
# CONFIG_TCP_CONG_BIC is not set
# CONFIG_TCP_CONG_HTCP is not set
# CONFIG_USB_EHCI_TT_NEWSCHED is not set
# CONFIG_VT is not set
CONFIG_AD5046_ACT=y
CONFIG_AEABI=y
CONFIG_ANDROID=y
CONFIG_ANDROID_BINDER_IPC=y
CONFIG_ANDROID_LOGGER=y
CONFIG_ANDROID_LOW_MEMORY_KILLER=y
CONFIG_ARCH_MSM7X27=y
CONFIG_ARCH_MSM8625=y
CONFIG_ARCH_MSM=y
CONFIG_ARM_THUMBEE=y
CONFIG_ASHMEM=y
CONFIG_BACKLIGHT_CLASS_DEVICE=y
CONFIG_BACKLIGHT_LCD_SUPPORT=y
CONFIG_BATTERY_MSM=y
CONFIG_BLK_DEV_DM=y
CONFIG_BLK_DEV_INITRD=y
CONFIG_BLK_DEV_LOOP=y
CONFIG_BLK_DEV_SD=y
CONFIG_BPF_JIT=y
CONFIG_BT=y
CONFIG_BT_HCIUART=y
CONFIG_BT_HCIUART_H4=y
CONFIG_BT_HCIUART_IBS=y
CONFIG_BT_HCIUART_LL=y
CONFIG_BT_HIDP=y
CONFIG_BT_MSM_PINTEST=y
CONFIG_BT_MSM_SLEEP=y
CONFIG_BT_RFCOMM=y
CONFIG_BT_RFCOMM_TTY=y
CONFIG_CC_OPTIMIZE_FOR_SIZE=y
CONFIG_CGROUPS=y
CONFIG_CGROUP_CPUACCT=y
CONFIG_CGROUP_DEVICE=y
CONFIG_CGROUP_FREEZER=y
CONFIG_CGROUP_SCHED=y
CONFIG_CHR_DEV_SCH=y
CONFIG_CHR_DEV_SG=y
CONFIG_CMDLINE="init=/sbin/init root=/dev/ram rw initrd=0x11000000,16M console=ttyDCC0 mem=88M"
CONFIG_COMPACTION=y
CONFIG_CPU_FREQ=y
CONFIG_CPU_FREQ_GOV_CONSERVATIVE=y
CONFIG_CPU_FREQ_GOV_INTERACTIVE=y
CONFIG_CPU_FREQ_GOV_ONDEMAND=y
CONFIG_CPU_FREQ_GOV_POWERSAVE=y
CONFIG_CPU_FREQ_GOV_USERSPACE=y
CONFIG_CPU_FREQ_STAT_DETAILS=y
CONFIG_CP_ACCESS=y
CONFIG_CRYPTO_TWOFISH=y
CONFIG_DEBUG_INFO_DWARF4=y
CONFIG_DEBUG_INFO_SPLIT=y
CONFIG_DEBUG_USER=y
CONFIG_DEFAULT_DEADLINE=y
CONFIG_DIAG_CHAR=y
CONFIG_DM_CRYPT=y
CONFIG_DYNAMIC_DEBUG=y
CONFIG_EMBEDDED=y
CONFIG_ENABLE_DEFAULT_TRACERS=y
CONFIG_EXPERIMENTAL=y
CONFIG_EXT2_FS=y
CONFIG_EXT2_FS_XATTR=y
CONFIG_EXT3_FS=y
CONFIG_EXT4_FS=y
CONFIG_FB=y
CONFIG_FB_AUTO_CABC=y
CONFIG_FB_DYNAMIC_GAMMA=y
CONFIG_FB_HUAWEI_MIPI_DSI_HX8357C=y
CONFIG_FB_HUAWEI_MIPI_DSI_HX8369A=y
CONFIG_FB_HUAWEI_MIPI_DSI_HX8369A_FWVGA=y
CONFIG_FB_HUAWEI_MIPI_DSI_HX8369B=y
CONFIG_FB_HUAWEI_MIPI_DSI_NT35510=y
CONFIG_FB_HUAWEI_MIPI_DSI_NT35510_FWVGA=y
CONFIG_FB_HUAWEI_MIPI_DSI_NT35512=y
CONFIG_FB_HUAWEI_MIPI_DSI_NT35516=y
CONFIG_FB_HUAWEI_MIPI_DSI_NT35560=y
CONFIG_FB_HUAWEI_MIPI_DSI_OTM8009A=y
CONFIG_FB_HUAWEI_MIPI_DSI_OTM8009A_FWVGA=y
CONFIG_FB_HUAWEI_MIPI_DSI_OTM8018B=y
CONFIG_FB_HUAWEI_MIPI_DSI_RSP61408=y
CONFIG_FB_MSM=y
CONFIG_FB_MSM_MDP303=y
CONFIG_FB_MSM_MDP30=y
CONFIG_FB_MSM_PANEL_NONE=y
CONFIG_FB_MSM_TRIPLE_BUFFER=y
CONFIG_FRAMEBUF_SELF_ADAPT=y
CONFIG_FUSE_FS=y
CONFIG_GENLOCK=y
CONFIG_GENLOCK_MISCDEVICE=y
CONFIG_GPIO_SLEEP=y
CONFIG_GPIO_SX150X=y
CONFIG_GPIO_SYSFS=y
CONFIG_HIGHMEM=y
CONFIG_HIGH_RES_TIMERS=y
CONFIG_HUAWEI_BT_BLUEZ_VER30=y
CONFIG_HUAWEI_CAMERA=y
CONFIG_HUAWEI_CAMERA_SENSOR_BF3905=y
CONFIG_HUAWEI_CAMERA_SENSOR_GC0313=y
CONFIG_HUAWEI_CAMERA_SENSOR_HI542=y
CONFIG_HUAWEI_CAMERA_SENSOR_IMX105=y
CONFIG_HUAWEI_CAMERA_SENSOR_MT9T113=y
CONFIG_HUAWEI_CAMERA_SENSOR_MT9V113=y
CONFIG_HUAWEI_CAMERA_SENSOR_S5K3H2=y
CONFIG_HUAWEI_CAMERA_SENSOR_S5K5CA=y
CONFIG_HUAWEI_EVALUATE_POWER_CONSUMPTION=y
CONFIG_HUAWEI_FEATURE_INPUT_ACCELEROMETER=y
CONFIG_HUAWEI_FEATURE_POWEROFF_ALARM=y
CONFIG_HUAWEI_FEATURE_PROXIMITY_EVERLIGHT_APS_12D=y
CONFIG_HUAWEI_FEATURE_PROXIMITY_EVERLIGHT_APS_9900=y
CONFIG_HUAWEI_FEATURE_RGB_KEY_LIGHT=y
CONFIG_HUAWEI_FEATURE_RMI_TOUCH=y
CONFIG_HUAWEI_FEATURE_SENSORS_ACCELEROMETER_ADI_ADXL346=y
CONFIG_HUAWEI_FEATURE_SENSORS_ACCELEROMETER_KXTIK1004=y
CONFIG_HUAWEI_FEATURE_SENSORS_ACCELEROMETER_MMA8452=y
CONFIG_HUAWEI_FEATURE_SENSORS_ACCELEROMETER_ST_LIS3XH=y
CONFIG_HUAWEI_FEATURE_SENSORS_AK8963=y
CONFIG_HUAWEI_FEATURE_SENSORS_AK8975=y
CONFIG_HUAWEI_FEATURE_TPS61310=y
CONFIG_HUAWEI_FEATURE_VIBRATOR=y
CONFIG_HUAWEI_GPIO_KEYPAD=y
CONFIG_HUAWEI_HW_DEV_DCT=y
CONFIG_HUAWEI_KERNEL=y
CONFIG_HUAWEI_MELFAS_TOUCHSCREEN=y
CONFIG_HUAWEI_MTK6252_MODEM=y
CONFIG_HUAWEI_NFC_PN544=y
CONFIG_HUAWEI_SENSOR_MT9P017=y
CONFIG_HUAWEI_SENSOR_S5K4E1=y
CONFIG_HUAWEI_SETTING_TIMER_FOR_VIBRATOR_OFF=y
CONFIG_HUAWEI_SMEM_SLEEP_LOG=y
CONFIG_HUAWEI_WIFI_SDCC=y
CONFIG_HW_TORCH=y
CONFIG_I2C=y
CONFIG_I2C_CHARDEV=y
CONFIG_I2C_QUP=y
CONFIG_IKCONFIG=y
CONFIG_IKCONFIG_PROC=y
CONFIG_INET6_AH=y
CONFIG_INET6_ESP=y
CONFIG_INET6_IPCOMP=y
CONFIG_INET=y
CONFIG_INET_AH=y
CONFIG_INET_ESP=y
CONFIG_INET_IPCOMP=y
CONFIG_INPUT_EVBUG=m
CONFIG_INPUT_EVDEV=y
CONFIG_INPUT_GPIO=y
CONFIG_INPUT_KEYCHORD=y
CONFIG_INPUT_MISC=y
CONFIG_INPUT_TOUCHSCREEN=y
CONFIG_INPUT_UINPUT=y
CONFIG_ION=y
CONFIG_ION_MSM=y
CONFIG_IP6_NF_FILTER=y
CONFIG_IP6_NF_IPTABLES=y
CONFIG_IP6_NF_MANGLE=y
CONFIG_IP6_NF_RAW=y
CONFIG_IP6_NF_TARGET_REJECT=y
CONFIG_IPV6=y
CONFIG_IPV6_MIP6=y
CONFIG_IPV6_MULTIPLE_TABLES=y
CONFIG_IPV6_OPTIMISTIC_DAD=y
CONFIG_IPV6_PRIVACY=y
CONFIG_IPV6_ROUTER_PREF=y
CONFIG_IPV6_ROUTE_INFO=y
CONFIG_IPV6_SUBTREES=y
CONFIG_IPV6_TUNNEL=y
CONFIG_IP_ADVANCED_ROUTER=y
CONFIG_IP_MULTIPLE_TABLES=y
CONFIG_IP_NF_ARPFILTER=y
CONFIG_IP_NF_ARPTABLES=y
CONFIG_IP_NF_ARP_MANGLE=y
CONFIG_IP_NF_FILTER=y
CONFIG_IP_NF_IPTABLES=y
CONFIG_IP_NF_MANGLE=y
CONFIG_IP_NF_MATCH_AH=y
CONFIG_IP_NF_MATCH_ECN=y
CONFIG_IP_NF_MATCH_TTL=y
CONFIG_IP_NF_RAW=y
CONFIG_IP_NF_TARGET_MASQUERADE=y
CONFIG_IP_NF_TARGET_NETMAP=y
CONFIG_IP_NF_TARGET_REDIRECT=y
CONFIG_IP_NF_TARGET_REJECT=y
CONFIG_KALLSYMS_ALL=y
CONFIG_KSM=y
CONFIG_KSM_CHECK_PAGE=y
CONFIG_LEDS_GPIO=y
CONFIG_LEDS_MSM_PDM=y
CONFIG_LEDS_MSM_TRICOLOR=y
CONFIG_LEDS_PMIC_MPP=y
CONFIG_LIBRA_SDIOIF=m
CONFIG_LOCALVERSION="-synopsis"
CONFIG_MACH_MSM7X27A_U8815=y
CONFIG_MACH_MSM8X25_C8812P=y
CONFIG_MACH_MSM8X25_C8813=y
CONFIG_MACH_MSM8X25_C8825D=y
CONFIG_MACH_MSM8X25_C8833D=y
CONFIG_MACH_MSM8X25_C8950D=y
CONFIG_MACH_MSM8X25_H881C=y
CONFIG_MACH_MSM8X25_U8825=y
CONFIG_MACH_MSM8X25_U8825D=y
CONFIG_MACH_MSM8X25_U8833=y
CONFIG_MACH_MSM8X25_U8833D=y
CONFIG_MACH_MSM8X25_U8950=y
CONFIG_MACH_MSM8X25_U8950D=y
CONFIG_MACH_MSM8X25_U8951=y
CONFIG_MACH_MSM8X25_U8951D=y
CONFIG_MAGIC_SYSRQ=y
CONFIG_MARIMBA_CORE=y
CONFIG_MD=y
CONFIG_MEDIA_CONTROLLER=y
CONFIG_MEDIA_SUPPORT=y
CONFIG_MMC=y
CONFIG_MMC_BLOCK_MINORS=32
CONFIG_MMC_CLKGATE=y
CONFIG_MMC_MSM=y
CONFIG_MMC_MSM_SDC3_8_BIT_SUPPORT=y
CONFIG_MMC_MSM_SDC3_SUPPORT=y
CONFIG_MMC_PARANOID_SD_INIT=y
CONFIG_MMC_PERF_PROFILING=y
CONFIG_MMC_UNSAFE_RESUME=y
CONFIG_MODULES=y
CONFIG_MODULE_UNLOAD=y
CONFIG_MSDOS_FS=y
CONFIG_MSM7X00A_USE_DG_TIMER=y
CONFIG_MSM7X27A_AUDIO=y
CONFIG_MSM_ACTUATOR=y
CONFIG_MSM_BT_POWER=y
CONFIG_MSM_CAMERA_SENSOR=y
CONFIG_MSM_CAMERA_V4L2=y
CONFIG_MSM_KGSL=y
CONFIG_MSM_KGSL_DISABLE_SHADOW_WRITES=y
CONFIG_MSM_MULTIMEDIA_USE_ION=y
CONFIG_MSM_ONCRPCROUTER=y
CONFIG_MSM_RMT_STORAGE_CLIENT=y
CONFIG_MSM_RPC_VIBRATOR=y
CONFIG_MSM_SLEEP_STATS_DEVICE=y
CONFIG_MSM_SMD=y
CONFIG_MSM_SMD_PKG4=y
CONFIG_MSM_SOC_REV_A=y
CONFIG_MSM_SPM_V2=y
CONFIG_MSM_VP_REGULATOR=y
CONFIG_MTD=y
CONFIG_MTD_BLOCK=y
CONFIG_MTD_CHAR=y
CONFIG_MTD_CMDLINE_PARTS=y
CONFIG_NEON=y
CONFIG_NET=y
CONFIG_NETDEVICES=y
CONFIG_NETFILTER=y
CONFIG_NETFILTER_NETLINK_LOG=y
CONFIG_NETFILTER_TPROXY=y
CONFIG_NETFILTER_XT_MATCH_COMMENT=y
CONFIG_NETFILTER_XT_MATCH_CONNLIMIT=y
CONFIG_NETFILTER_XT_MATCH_CONNMARK=y
CONFIG_NETFILTER_XT_MATCH_CONNTRACK=y
CONFIG_NETFILTER_XT_MATCH_HASHLIMIT=y
CONFIG_NETFILTER_XT_MATCH_HELPER=y
CONFIG_NETFILTER_XT_MATCH_IPRANGE=y
CONFIG_NETFILTER_XT_MATCH_LENGTH=y
CONFIG_NETFILTER_XT_MATCH_LIMIT=y
CONFIG_NETFILTER_XT_MATCH_MAC=y
CONFIG_NETFILTER_XT_MATCH_MARK=y
CONFIG_NETFILTER_XT_MATCH_PKTTYPE=y
CONFIG_NETFILTER_XT_MATCH_POLICY=y
CONFIG_NETFILTER_XT_MATCH_QTAGUID=y
CONFIG_NETFILTER_XT_MATCH_QUOTA2=y
CONFIG_NETFILTER_XT_MATCH_QUOTA2_LOG=y
CONFIG_NETFILTER_XT_MATCH_QUOTA=y
CONFIG_NETFILTER_XT_MATCH_SOCKET=y
CONFIG_NETFILTER_XT_MATCH_STATE=y
CONFIG_NETFILTER_XT_MATCH_STATISTIC=y
CONFIG_NETFILTER_XT_MATCH_STRING=y
CONFIG_NETFILTER_XT_MATCH_TIME=y
CONFIG_NETFILTER_XT_MATCH_U32=y
CONFIG_NETFILTER_XT_TARGET_CLASSIFY=y
CONFIG_NETFILTER_XT_TARGET_CONNMARK=y
CONFIG_NETFILTER_XT_TARGET_LOG=y
CONFIG_NETFILTER_XT_TARGET_MARK=y
CONFIG_NETFILTER_XT_TARGET_NFQUEUE=y
CONFIG_NET_IPIP=y
CONFIG_NET_KEY=y
CONFIG_NET_KEY_MIGRATE=y
CONFIG_NFC=y
CONFIG_NF_CONNTRACK=y
CONFIG_NF_CONNTRACK_AMANDA=y
CONFIG_NF_CONNTRACK_EVENTS=y
CONFIG_NF_CONNTRACK_FTP=y
CONFIG_NF_CONNTRACK_H323=y
CONFIG_NF_CONNTRACK_IPV4=y
CONFIG_NF_CONNTRACK_IRC=y
CONFIG_NF_CONNTRACK_NETBIOS_NS=y
CONFIG_NF_CONNTRACK_PPTP=y
CONFIG_NF_CONNTRACK_SANE=y
CONFIG_NF_CONNTRACK_SIP=y
CONFIG_NF_CONNTRACK_TFTP=y
CONFIG_NF_CT_NETLINK=y
CONFIG_NF_CT_PROTO_DCCP=y
CONFIG_NF_CT_PROTO_SCTP=y
CONFIG_NF_CT_PROTO_UDPLITE=y
CONFIG_NF_NAT=y
CONFIG_NLS_ASCII=y
CONFIG_NLS_CODEPAGE_437=y
CONFIG_NLS_ISO8859_1=y
CONFIG_NO_HZ=y
CONFIG_OPROFILE=y
CONFIG_OV5647=y
CONFIG_PACKET=y
CONFIG_PARTITION_ADVANCED=y
CONFIG_PM8XXX_RPC_VIBRATOR=y
CONFIG_PM_RUNTIME=y
CONFIG_POWER_SUPPLY=y
CONFIG_PPP=y
CONFIG_PPPOE=m
CONFIG_PPPOLAC=y
CONFIG_PPPOPNS=y
CONFIG_PPP_ASYNC=y
CONFIG_PPP_BSDCOMP=y
CONFIG_PPP_DEFLATE=y
CONFIG_PPP_FILTER=y
CONFIG_PPP_MPPE=y
CONFIG_PPP_MULTILINK=y
CONFIG_PPP_SYNC_TTY=y
CONFIG_PREEMPT=y
CONFIG_PRINTK_TIME=y
CONFIG_QWERTY_KEYPAD_ADP5587=y
CONFIG_RADIO_TAVARUA=y
CONFIG_REGULATOR_GPIO=y
CONFIG_REGULATOR_MSM_GPIO=y
CONFIG_RESOURCE_COUNTERS=y
CONFIG_RFKILL=y
CONFIG_RMNET_SMD_CTL_CHANNEL="DATA40_CNTL"
CONFIG_RMNET_SMD_DATA_CHANNEL="DATA40"
CONFIG_RTC_CLASS=y
CONFIG_RT_GROUP_SCHED=y
CONFIG_SCHED_STATS=y
CONFIG_SCSI=y
CONFIG_SCSI_CONSTANTS=y
CONFIG_SCSI_LOGGING=y
CONFIG_SCSI_MULTI_LUN=y
CONFIG_SCSI_SCAN_ASYNC=y
CONFIG_SCSI_TGT=y
CONFIG_SENSORS_MSM_ADC=y
CONFIG_SERIAL_MSM=y
CONFIG_SERIAL_MSM_CONSOLE=y
CONFIG_SERIAL_MSM_HS=y
CONFIG_SMC91X=y
CONFIG_SMP=y
CONFIG_SMSC911X=y
CONFIG_SND=y
CONFIG_SND_MSM_SOC=y
CONFIG_SND_SOC=y
CONFIG_SOUND=y
CONFIG_STAGING=y
CONFIG_STRICT_DEVMEM=y
CONFIG_SUPPORT_SYSTEMTAP=y
CONFIG_SWITCH=y
CONFIG_SWITCH_GPIO=y
CONFIG_SYSVIPC=y
CONFIG_TCP_CONG_ADVANCED=y
CONFIG_TCP_CONG_WESTWOOD=y
CONFIG_TIMER_STATS=y
CONFIG_TMPFS=y
CONFIG_TOUCHSCREEN_ATMEL_MXT=y
CONFIG_TOUCHSCREEN_FT5X06=y
CONFIG_TOUCHSCREEN_SYNAPTICS_RMI4_I2C=y
CONFIG_TUN=y
CONFIG_UHID=y
CONFIG_UID_STAT=y
CONFIG_UNIX=y
CONFIG_USB=y
CONFIG_USB_ACM=y
CONFIG_USB_ANNOUNCE_NEW_DEVICES=y
CONFIG_USB_EHCI_EHSET=y
CONFIG_USB_EHCI_HCD=y
CONFIG_USB_EHCI_MSM_72K=y
CONFIG_USB_EHCI_ROOT_HUB_TT=y
CONFIG_USB_EHSET_TEST_FIXTURE=y
CONFIG_USB_GADGET=y
CONFIG_USB_G_ANDROID=y
CONFIG_USB_MSM_72K=y
CONFIG_USB_STORAGE=y
CONFIG_USB_STORAGE_ALAUDA=y
CONFIG_USB_STORAGE_CYPRESS_ATACB=y
CONFIG_USB_STORAGE_DATAFAB=y
CONFIG_USB_STORAGE_FREECOM=y
CONFIG_USB_STORAGE_ISD200=y
CONFIG_USB_STORAGE_JUMPSHOT=y
CONFIG_USB_STORAGE_KARMA=y
CONFIG_USB_STORAGE_ONETOUCH=y
CONFIG_USB_STORAGE_SDDR09=y
CONFIG_USB_STORAGE_SDDR55=y
CONFIG_USB_STORAGE_USBAT=y
CONFIG_USB_SUSPEND=y
CONFIG_V4L_PLATFORM_DRIVERS=y
CONFIG_VFAT_FS=y
CONFIG_VFP=y
CONFIG_VIDEOBUF2_MSM_MEM=y
CONFIG_VIDEO_DEV=y
CONFIG_VIDEO_V4L2_SUBDEV_API=y
CONFIG_VMALLOC_RESERVE=0x18000000
CONFIG_WAKELOCK=y
CONFIG_YAFFS_DISABLE_TAGS_ECC=y
CONFIG_YAFFS_FS=y
CONFIG_ZBOOT_ROM_BSS=0x0
CONFIG_ZBOOT_ROM_TEXT=0x0
```
